## fit-image/fitimage-example.its
```
/*
 * U-Boot uImage source file for the <platform>
 * Note that 'data' paths are relative to the current working directory where
 * mkimage is invoked in the fit-image part!
 * It's most convenient if all the relevant blobs are in the stage/ directory.
 * This is just some minimum viable example; see the official documentation:
 * https://doc.coreboot.org/lib/payloads/fit.html
 * Please update any <info> or ${variables} as needed!
 */

/dts-v1/;

/ {
	description = "Ubuntu Core kernel, ramdisk, and FDT blob for <platform>";
	#address-cells = <1>;

	images {
		kernel {
			description = "Ubuntu Kernel";
			data = /incbin/("../../../stage/Image");
			type = "kernel";
			arch = "${CRAFT_ARCH_BUILD_FOR}";
			os = "linux";
			compression = "none";
			load =  <some memory address, perhaps kernel_addr_r>;
			entry = <some memory address, perhaps kernel_addr_r>;
			hash {
				algo = "sha256";
			};
		};
		ramdisk {
			description = "Ubuntu Core ramdisk";
			data = /incbin/("../../../stage/initrd.img");
			type = "ramdisk";
			arch = "${CRAFT_ARCH_BUILD_FOR}";
			os = "linux";
			compression = "none";
			load =  <some memory address, perhaps ramdisk_addr_r>;
			hash {
				algo = "sha256";
			};
		};
		<device-tree-name>.dtb {
			description = "<platform> DTB";
			data = /incbin/("../../../stage/dtbs/<platform>.dtb");
			type = "flat_dt";
			arch = "${CRAFT_ARCH_BUILD_FOR}";
			compression = "none";
			load =  <some memory address, perhaps fdt_addr_r>;
			hash {
				algo = "sha256";
			};
		};
	};
	configurations {
		default = "<configuration name>";
		<configuration name> {
			description = "<apt description>";
			kernel = "kernel";
			ramdisk = "ramdisk";
			fdt = "<device-tree-name>.dtb";
			hash {
				algo = "sha256";
			};
		};
	};
};
```

## imx/fit-image/kernel_arm64.its
```
/*
 * U-Boot uImage source file with multiple kernels, ramdisks and FDT blobs
 */

/dts-v1/;

/ {
	description = "Ubuntu Core kernel, ramdisk and FDT blobs for i.MX8M board family";
	#address-cells = <1>;

	images {
		kernel-ubuntu {
			description = "ubuntu-kernel";
			data = /incbin/("vmlinuz");
			type = "kernel";
			arch = "arm64";
			os = "linux";
			compression = "none";
			load =  <0x80480000>;
			entry = <0x80480000>;
			hash-1 {
				algo = "sha256";
			};
		};

		ramdisk-uc {
			description = "Ubuntu-Core-ramdisk";
			data = /incbin/("initrd.img");
			type = "ramdisk";
			arch = "arm64";
			os = "linux";
			compression = "none";
			load =  <0x83800000>;
			entry = <0x83800000>;
			hash-1 {
				algo = "sha256";
			};
		};

		fdt-imx93-11x11-evk {
			description = "i.MX93-11x11-EVK";
			data = /incbin/("dtbs/freescale/imx93-11x11-evk.dtb");
			type = "flat_dt";
			arch = "arm64";
			compression = "none";
			load =  <0x83000000>;
			entry = <0x83000000>;
			hash-1 {
				algo = "sha256";
			};
		};

		fdt-imx93-9x9-qsb {
			description = "i.MX93-9x9-QSB";
			data = /incbin/("dtbs/freescale/imx93-9x9-qsb.dtb");
			type = "flat_dt";
			arch = "arm64";
			compression = "none";
			load =  <0x83000000>;
			entry = <0x83000000>;
			hash-1 {
				algo = "sha256";
			};
		};

		fdt-imx93-11x11-frdm {
			description = "FRDM i.MX93 Development Board";
			data = /incbin/("dtbs/freescale/imx93-11x11-frdm.dtb");
			type = "flat_dt";
			arch = "arm64";
			compression = "none";
			load =  <0x83000000>;
			entry = <0x83000000>;
			hash-1 {
				algo = "sha256";
			};
		};
		fdt-imx91-11x11-frdm {
			description = "FRDM i.MX91 Development Board";
			data = /incbin/("dtbs/freescale/imx91-11x11-frdm.dtb");
			type = "flat_dt";
			arch = "arm64";
			compression = "none";
			load =  <0x83000000>;
			entry = <0x83000000>;
			hash-1 {
				algo = "sha256";
			};
		};
	};

	configurations {
	default = "imx93-11x11-evk.dtb";

		imx93-11x11-evk.dtb {
			description = "i.MX93 EVK";
			kernel = "kernel-ubuntu";
			ramdisk = "ramdisk-uc";
			fdt = "fdt-imx93-11x11-evk";
			signature-1 {
				algo = "sha256,rsa2048";
				key-name-hint="dev-key";
				sign-images="fdt","kernel", "ramdisk";
			};
		};

		imx93-9x9-qsb.dtb {
			description = "i.MX93 QSB";
			kernel = "kernel-ubuntu";
			ramdisk = "ramdisk-uc";
			fdt = "fdt-imx93-9x9-qsb";
			signature-1 {
				algo = "sha256,rsa2048";
				key-name-hint="dev-key";
				sign-images="fdt","kernel", "ramdisk";
			};
		};

		imx93-11x11-frdm.dtb {
			description = "i.MX93 FRDM";
			kernel = "kernel-ubuntu";
			ramdisk = "ramdisk-uc";
			fdt = "fdt-imx93-11x11-frdm";
			signature-1 {
				algo = "sha256,rsa2048";
				key-name-hint="dev-key";
				sign-images="fdt","kernel", "ramdisk";
			};
		};
		imx91-11x11-frdm.dtb {
			description = "i.MX91 FRDM";
			kernel = "kernel-ubuntu";
			ramdisk = "ramdisk-uc";
			fdt = "fdt-imx91-11x11-frdm";
			signature-1 {
				algo = "sha256,rsa2048";
				key-name-hint="dev-key";
				sign-images="fdt","kernel", "ramdisk";
			};
		};
	};
};
```

## imx/fit-image/kernel_armhf.its
```
/*
 * U-Boot uImage source file with multiple kernels, ramdisks and FDT blobs
 */

/dts-v1/;

/ {
	description = "Ubuntu Core kernel, ramdisk and FDT blobs for i.MX8M board family";
	#address-cells = <1>;

	images {
		kernel-ubuntu {
			description = "ubuntu-kernel";
			data = /incbin/("./kernel.img");
			type = "kernel";
			arch = "arm";
			os = "linux";
			compression = "none";
			load =  <0x82100000>;
			entry = <0x82100000>;
			hash-1 {
				algo = "sha256";
			};
		};

		ramdisk-uc {
			description = "Ubuntu-Core-ramdisk";
			data = /incbin/("./initrd.img");
			type = "ramdisk";
			arch = "arm";
			os = "linux";
			compression = "none";
			load =  <0x86800000>;
			entry = <0x86800000>;
			hash-1 {
				algo = "sha256";
			};
		};

		fdt-imx6sx-x6med35-pdk {
			description = "i.MX6SX_X6Med-35-PDK";
			data = /incbin/("./dtbs/imx6sx-x6med35-pdk.dtb");
			type = "flat_dt";
			arch = "arm";
			compression = "none";
			load =  <0x83000000>;
			entry = <0x83000000>;
			hash-1 {
				algo = "sha256";
			};
		};

		optee {
			description = "OP-TEE";
			data = /incbin/("./tee.mx6sx.bin");
			type = "kernel";
			arch = "arm";
			os = "linux";
			compression = "none";
			load = <0x84000000>;
			entry = <0x84000000>;
			hash-1 {
				algo = "sha256";
			};
		};
	};

	configurations {
		default = "imx6sx-x6med35-pdk.dtb";
		imx6sx-x6med35-pdk.dtb {
			description = "i.MX6SoloX X6Med-35-PDK";
			kernel = "optee";
			loadables = "kernel-ubuntu";
			ramdisk = "ramdisk-uc";
			fdt = "fdt-imx6sx-x6med35-pdk";
			signature-1 {
				algo = "sha256,rsa2048";
				key-name-hint="dev-key";
				sign-images="fdt","kernel", "ramdisk";
			};
		};
	};
};
```

## nezha/fit-image/kernel_riscv64.its
```
/dts-v1/;

/ {
	description = "Ubuntu Core kernel, ramdisk and FDT blobs";
	#address-cells = <1>;

	images {
		kernel-ubuntu {
			description = "ubuntu-kernel";
			data = /incbin/("kernel.img");
			type = "kernel";
			arch = "riscv";
			os = "linux";
			compression = "none";
			load =  <0x41000000>;
			entry = <0x41000000>;

			hash-1 {
				algo = "sha256";
			};
		};

		ramdisk-uc {
			description = "Ubuntu-Core-ramdisk";
			data = /incbin/("initrd.img");
			type = "ramdisk";
			arch = "riscv";
			os = "linux";
			compression = "none";
			load =  <0x43000000>;
			entry = <0x43000000>;

			hash-1 {
				algo = "sha256";
			};
		};

		fdt-sun20i-d1-nezha {
			description = "Nezha";
			data = /incbin/("dtbs/sun20i-d1-nezha.dtb");
			type = "flat_dt";
			arch = "riscv";
			compression = "none";
			load =  <0x44000000>;
			entry = <0x44000000>;

			hash-1 {
				algo = "sha256";
			};
		};

		fdt-sun20i-d1-lichee-rv {
			description = "Sipeed Lichee RV";
			data = /incbin/("dtbs/sun20i-d1-lichee-rv.dtb");
			type = "flat_dt";
			arch = "riscv";
			compression = "none";
			load =  <0x44000000>;
			entry = <0x44000000>;

			hash-1 {
				algo = "sha256";
			};
		};

		fdt-sun20i-d1-lichee-rv-dock {
			description = "Sipeed Lichee RV + Dock";
			data = /incbin/("dtbs/sun20i-d1-lichee-rv-dock.dtb");
			type = "flat_dt";
			arch = "riscv";
			compression = "none";
			load =  <0x44000000>;
			entry = <0x44000000>;

			hash-1 {
				algo = "sha256";
			};
		};
	};

	configurations {
		default = "sun20i-d1-nezha";

		sun20i-d1-nezha {
			description = "Nezha";
			kernel = "kernel-ubuntu";
			ramdisk = "ramdisk-uc";
			fdt = "fdt-sun20i-d1-nezha";
		};

		sun20i-d1-lichee-rv {
			description = "Sipeed Lichee RV";
			kernel = "kernel-ubuntu";
			ramdisk = "ramdisk-uc";
			fdt = "fdt-sun20i-d1-lichee-rv";
		};

		sun20i-d1-lichee-rv-dock {
			description = "Sipeed Lichee RV + Dock";
			kernel = "kernel-ubuntu";
			ramdisk = "ramdisk-uc";
			fdt = "fdt-sun20i-d1-lichee-rv-dock";
		};
	};
};
```

## orangepi-5plus/fit-image/kernel_arm64.its
```
/*
 * U-Boot uImage source file with multiple kernels, ramdisks and FDT blobs
 */

/dts-v1/;

/ {
	description = "Ubuntu Core kernel, ramdisk and FDT blobs for Orange Pi 5+";
	#address-cells = <1>;

	images {
		kernel-ubuntu {
			description = "ubuntu-kernel";
			data = /incbin/("../../../stage/Image");
			type = "kernel";
			arch = "arm64";
			os = "linux";
			compression = "gzip";
			load =  <0x80000000>;
			entry = <0x80000000>;

			hash-1 {
				algo = "sha256";
			};
		};

		ramdisk-uc {
			description = "Ubuntu-Core-ramdisk";
			data = /incbin/("../../../stage/initrd.img");
			type = "ramdisk";
			arch = "arm64";
			os = "linux";
			compression = "none";
			load =  <0x90000000>;

			hash-1 {
				algo = "sha256";
			};
		};

		fdt-rk3588-orangepi-5-plus {
			description = "Orange Pi 5+";
			data = /incbin/("../../../stage/dtbs/rockchip/rk3588-orangepi-5-plus.dtb");
			type = "flat_dt";
			arch = "arm64";
			compression = "none";
			load =  <0x8F000000>;

			hash-1 {
				algo = "sha256";
			};
		};
	};

	configurations {
		default = "rk3588-orangepi-5-plus";

		rk3588-orangepi-5-plus {
			description = "Orange Pi 5+";
			kernel = "kernel-ubuntu";
			ramdisk = "ramdisk-uc";
			fdt = "fdt-rk3588-orangepi-5-plus";
		};
	};
};
```

## visionfive2/fit-image/fitImage-riscv64.its
```
/*
 * U-Boot uImage source file for the VisionFive StarFive 2
 */

/dts-v1/;

/ {
	description = "Ubuntu Core kernel, ramdisk, and FDT blob for VisionFive StarFive 2";
	#address-cells = <1>;

	images {
		kernel {
			description = "Ubuntu Kernel";
			data = /incbin/("vmlinuz");
			type = "kernel";
			arch = "riscv";
			os = "linux";
			compression = "none";
			load =  <0x40200000>;
			entry = <0x40200000>;
			hash {
				algo = "sha256";
			};
		};
		ramdisk {
			description = "Ubuntu Core ramdisk";
			data = /incbin/("initrd.img");
			type = "ramdisk";
			arch = "riscv";
			os = "linux";
			compression = "none";
			load =  <0x46100000>;
			hash {
				algo = "sha256";
			};
		};
		fdt-starfive-visionfive-2-v1.2a.dtb {
			description = "StarFive VisionFive 2 v1.2a DTB";
			data = /incbin/("dtbs/device-tree/starfive/jh7110-starfive-visionfive-2-v1.2a.dtb");
			type = "flat_dt";
			arch = "riscv";
			compression = "none";
			load =  <0x46000000>;
			hash {
				algo = "sha256";
			};
		};
		fdt-starfive-visionfive-2-v1.3b.dtb {
			description = "StarFive VisionFive 2 v1.3b DTB";
			data = /incbin/("dtbs/device-tree/starfive/jh7110-starfive-visionfive-2-v1.3b.dtb");
			type = "flat_dt";
			arch = "riscv";
			compression = "none";
			load =  <0x46000000>;
			hash {
				algo = "sha256";
			};
		};
	};
	configurations {
		default = "starfive-visionfive-2-v1.2a";
		starfive-visionfive-2-v1.2a {
			description = "StarFive VisionFive 2 v1.2a";
			kernel = "kernel";
			ramdisk = "ramdisk";
			fdt = "fdt-starfive-visionfive-2-v1.2a.dtb";
			hash {
				algo = "sha256";
			};
		};
		starfive-visionfive-2-v1.3b {
			description = "StarFive VisionFive 2 v1.3b";
			kernel = "kernel";
			ramdisk = "ramdisk";
			fdt = "fdt-starfive-visionfive-2-v1.3b.dtb";
			hash {
				algo = "sha256";
			};
		};
	};
};
```

## visionfive2/fit-image/kernel_riscv64.its
```
/dts-v1/;

/ {
        description = "Ubuntu Core kernel, ramdisk, and FDT blobs";
        #address-cells = <1>;

        images {
                kernel-ubuntu {
                        description = "ubuntu-kernel";
                        data = /incbin/("kernel.img");
                        type = "kernel";
                        arch = "riscv";
                        os = "linux";
                        compression = "none";
                        load =  <0x0 0x40200000>;
                        entry = <0x0 0x40200000>;
						hash-1 {
							algo = "sha256";
						};
                };

                ramdisk-uc {
                        description = "Ubuntu-Core-ramdisk";
                        data = /incbin/("initrd.img");
                        type = "ramdisk";
                        arch = "riscv";
                        os = "linux";
                        compression = "none";
                        load =  <0x0 0x46100000>;
                        entry = <0x0 0x46100000>;
                        hash-1 {
                            algo = "sha256";
                        };
                };

                fdt-visionfive2-1.2a {
                        data = /incbin/("dtbs/starfive/jh7110-starfive-visionfive-2-v1.2a.dtb");
                        type = "flat_dt";
                        arch = "riscv";
                        compression = "none";
                        load =  <0x0 0x46000000>;
                        entry = <0x0 0x46000000>;
                        hash-1 {
                            algo = "sha256";
                        };
                };

                fdt-visionfive2-1.3b {
                        data = /incbin/("dtbs/starfive/jh7110-starfive-visionfive-2-v1.3b.dtb");
                        type = "flat_dt";
                        arch = "riscv";
                        compression = "none";
                        load =  <0x0 0x46000000>;
                        entry = <0x0 0x46000000>;
                        hash-1 {
                            algo = "sha256";
                        };
                };
        };

        configurations {
                default = "jh7110-1.2a";

                jh7110-1.2a {
                        description = "visionfive2 rev 1.2a";
						kernel = "kernel-ubuntu";
                        ramdisk = "ramdisk-uc";
                        fdt = "fdt-visionfive2-1.2a";
                };

                jh7110-1.3b {
                        description = "visionfive2 rev 1.3b";
						kernel = "kernel-ubuntu";
                        ramdisk = "ramdisk-uc";
                        fdt = "fdt-visionfive2-1.3b";
                };
        };
};
```
